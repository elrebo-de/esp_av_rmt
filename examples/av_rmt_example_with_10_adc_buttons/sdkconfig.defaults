## examples/av_rmt_example_with_10_adc_buttons/sdkconfig.defaults
```kconfig
CONFIG_PARTITION_TABLE_SINGLE_APP_LARGE=y
// no internal resistors pulling up the ADC GPIO
CONFIG_ESP_SLEEP_GPIO_ENABLE_INTERNAL_RESISTORS=n
// we need 10 ADC buttons (default is 8)
CONFIG_ADC_BUTTON_MAX_BUTTON_PER_CHANNEL=10
```

## examples/av_rmt_example_with_adc_buttons/sdkconfig.defaults
```kconfig
CONFIG_PARTITION_TABLE_SINGLE_APP_LARGE=y
// no internal resistors pulling up the ADC GPIO
CONFIG_ESP_SLEEP_GPIO_ENABLE_INTERNAL_RESISTORS=n
```
